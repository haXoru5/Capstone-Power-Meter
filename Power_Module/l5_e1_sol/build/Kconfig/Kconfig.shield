## Power_Module/l5_e1_sol/build/Kconfig/Kconfig.shield
```kconfig
osource "C:/Users/micha/blinky/boards/shields/*/Kconfig.shield"
osource "C:/Users/micha/peripheral_status/boards/shields/*/Kconfig.shield"
osource "C:/Users/micha/peripheral_uart/boards/shields/*/Kconfig.shield"
osource "C:/Users/micha/central_uart/boards/shields/*/Kconfig.shield"
osource "C:/Users/micha/adc_sequence/boards/shields/*/Kconfig.shield"
osource "C:/Users/micha/spi_flash/boards/shields/*/Kconfig.shield"
osource "C:/Users/micha/Documents/GitHub/ncs-inter/v2.9.0-v2.7.0/l5/l5_e1_sol/boards/shields/*/Kconfig.shield"
osource "C:/Users/micha/Documents/GitHub/ncs-fund/v2.9.0-v2.7.0/l6/l6_e1_sol/boards/shields/*/Kconfig.shield"
osource "C:/ncs/v2.9.0/nrf/boards/shields/*/Kconfig.shield"
```

## Power_Module/l5_e1_sol/build/Kconfig/boards/Kconfig
```kconfig
# Load Zephyr board Kconfig descriptions.
osource "C:/ncs/v2.9.0/zephyr/boards/boards/CycleSense/blinky_test/Kconfig"
```

## Power_Module/l5_e1_sol/build_1/l5_e1_sol/Kconfig/Kconfig.shield.defconfig
```kconfig
osource "C:/Users/micha/Documents/GitHub/Capstone-Power-Meter/Power_Module/l5_e1_sol/boards/shields/*/Kconfig.defconfig"
osource "C:/ncs/v2.9.0/nrf/boards/shields/*/Kconfig.defconfig"
```

## Power_Module/peripheral_uart/build_2/peripheral_uart/Kconfig/Kconfig.shield.defconfig
```kconfig
osource "C:/Users/micha/blinky/boards/shields/*/Kconfig.defconfig"
osource "C:/Users/micha/peripheral_status/boards/shields/*/Kconfig.defconfig"
osource "C:/Users/micha/peripheral_uart/boards/shields/*/Kconfig.defconfig"
osource "C:/Users/micha/central_uart/boards/shields/*/Kconfig.defconfig"
osource "C:/Users/micha/adc_sequence/boards/shields/*/Kconfig.defconfig"
osource "C:/Users/micha/spi_flash/boards/shields/*/Kconfig.defconfig"
osource "C:/Users/micha/Documents/GitHub/ncs-inter/v2.9.0-v2.7.0/l5/l5_e1_sol/boards/shields/*/Kconfig.defconfig"
osource "C:/Users/micha/Documents/GitHub/ncs-fund/v2.9.0-v2.7.0/l6/l6_e1_sol/boards/shields/*/Kconfig.defconfig"
osource "C:/Users/micha/peripheral_uart_1/boards/shields/*/Kconfig.defconfig"
osource "C:/ncs/v2.9.0/nrf/boards/shields/*/Kconfig.defconfig"
```

## Power_Module/peripheral_uart/build_2/peripheral_uart/Kconfig/boards/Kconfig.defconfig
```kconfig
# Load Zephyr board defconfig descriptions.
osource "C:/ncs/v2.9.0/zephyr/boards/boards/CycleSense/blinky_test/Kconfig.defconfig"
```
